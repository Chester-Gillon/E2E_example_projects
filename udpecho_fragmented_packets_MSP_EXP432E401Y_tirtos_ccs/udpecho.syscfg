/**
 * @cliArgs --board "/ti/boards/MSP_EXP432E401Y" --product "simplelink_msp432e4_sdk@4.20.00.12"
 * @versions {"data":"2020090214","timestamp":"2020090214","tool":"1.6.0+1543","templates":"2020090214"}
 */

/**
 * Import the modules used in this configuration.
 */
const Display  = scripting.addModule("/ti/display/Display");
const Display1 = Display.addInstance();
const RTOS     = scripting.addModule("/ti/drivers/RTOS");
const General  = scripting.addModule("/ti/ndk/General");
const NIMU     = scripting.addModule("/ti/ndk/NIMU");
const NIMU1    = NIMU.addInstance();
const SlNet    = scripting.addModule("/ti/net/SlNet");
const SlNet1   = SlNet.addInstance();

/**
 * Write custom configuration values to the imported modules.
 */
Display1.$name      = "CONFIG_Display_0";
Display1.$hardware  = system.deviceData.board.components.XDS110UART;
Display1.uart.$name = "CONFIG_UART_0";


General.ndkThreadStkSize      = 2048;
General.lowPriTaskDefStkSize  = 2048;
General.normPriTaskDefStkSize = 2048;
General.highPriTaskDefStkSize = 2048;
General.networkIPAddrHook     = "netIPAddrHook";
General.tcpTxBufSize          = 1024;
General.tcpRxBufSize          = 1024;
General.tcpRxBufLimit         = 2048;
General.udpRxBufSize          = 4096;
General.initHook              = "netStackInitHook";
General.pageSize              = 4096;

NIMU1.$name              = "CONFIG_NIMU_0";
NIMU1.dhcpcServReportFxn = "serviceReport";
NIMU1.emac.$name         = "CONFIG_EMAC_0";

SlNet1.$name             = "CONFIG_SLNET_0";
SlNet1.id                = 2;
SlNet1.enableSecureSocks = false;

/**
 * Pinmux solution for unlocked pins/peripherals. This ensures that minor changes to the automatic solver in a future
 * version of the tool will not impact the pinmux you originally saw.  These lines can be completely deleted in order to
 * re-solve from scratch.
 */
Display1.uart.uart.$suggestSolution       = "UART0";
Display1.uart.uart.txPin.$suggestSolution = "expansion.76";
Display1.uart.uart.rxPin.$suggestSolution = "expansion.74";
RTOS.timer0.resource.$suggestSolution     = "Timer0";
NIMU1.emac.emac.$suggestSolution          = "ETHERNET0";
NIMU1.emac.emac.led0Pin.$suggestSolution  = "boosterpack2.39";
NIMU1.emac.emac.led1Pin.$suggestSolution  = "boosterpack2.32";
